## Soluciones/3-logger/components/storage-manager/Kconfig.projbuild
```kconfig
menu "Logger Storage Configuration"
    config STORAGE_PARTITION_LABEL
        string "Storage Partition Label"
        default "storage"
        help
            The label of the partition to use for storage. This partition must be
            defined in the partition table CSV file.

endmenu
```
